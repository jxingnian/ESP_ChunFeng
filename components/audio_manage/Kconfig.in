## components/audio_manage/Kconfig.in
```kconfig
menu "Audio Board"

choice AUDIO_BOARD
    prompt "Audio board"
    default AUDIO_BOARD_WEIXUE_1_8_AMOLED
config AUDIO_BOARD_WEIXUE_1_8_AMOLED
    bool "WeiXue-ESP32-S3-1.8-AMOLED"

endchoice

endmenu
```

## components/wifi_manage/Kconfig.in
```kconfig
menu "WIFI Configuration"
    
config ESP_AP_SSID
    string "AP SSID"
    default "chunfeng"
    help
        SSID (network name) for the AP to broadcast.

config ESP_AP_PASSWORD
    string "AP Password"
    default "chunfeng"
    help
        AP password (WPA or WPA2) for the AP to use.
        
# Removed ESP_WIFI_CHANNEL and ESP_MAX_STA_CONN
endmenu
```

## sdkconfig.defaults
```kconfig
# ESP-IDF Basic Configuration
CONFIG_IDF_CMAKE=y
CONFIG_IDF_TARGET_ARCH_XTENSA=y
CONFIG_IDF_TARGET="esp32s3"
CONFIG_IDF_TARGET_ESP32S3=y
CONFIG_ESPTOOLPY_FLASHSIZE_16MB=y
CONFIG_IDF_FIRMWARE_CHIP_ID=0x0009

CONFIG_ESP_TLS_INSECURE=y
CONFIG_ESP_TLS_SKIP_SERVER_CERT_VERIFY=y

# CPU Frequency Configuration
CONFIG_ESP32S3_DEFAULT_CPU_FREQ_240=y
CONFIG_ESP_DEFAULT_CPU_FREQ_MHZ_240=y

# Partition Table Configuration
CONFIG_PARTITION_TABLE_CUSTOM=y
CONFIG_PARTITION_TABLE_CUSTOM_FILENAME="partitions.csv"
CONFIG_PARTITION_TABLE_OFFSET=0x8000

# PSRAM (External SPI RAM) Configuration
CONFIG_ESP32S3_SPIRAM_SUPPORT=y
CONFIG_SPIRAM=y
CONFIG_SPIRAM_MODE_OCT=y
CONFIG_SPIRAM_TYPE_AUTO=y
CONFIG_SPIRAM_SPEED_80M=y
CONFIG_SPIRAM_BOOT_INIT=y
CONFIG_SPIRAM_MEMTEST=y
CONFIG_SPIRAM_TRY_ALLOCATE_WIFI_LWIP=y
CONFIG_SPIRAM_USE_CAPS_ALLOC=y

# Hardware and Performance Configuration
CONFIG_ESPTOOLPY_FLASHMODE_QIO=y
CONFIG_COMPILER_OPTIMIZATION_PERF=y
CONFIG_SPIRAM_FETCH_INSTRUCTIONS=y
CONFIG_SPIRAM_RODATA=y
CONFIG_ESP32S3_DATA_CACHE_LINE_64B=y
CONFIG_ESP32S3_DATA_CACHE_LINE_SIZE=64
CONFIG_ESP32S3_DATA_CACHE_64KB=y
CONFIG_ESP32S3_DATA_CACHE_SIZE=0x20000

# UART and Console Configuration
CONFIG_ESP_CONSOLE_USB_SERIAL_JTAG=y
CONFIG_FLASHMODE_QIO=y

# FreeRTOS Configuration
CONFIG_FREERTOS_HZ=1000
CONFIG_ESP_MAIN_TASK_STACK_SIZE=4096

# LVGL Font Configuration
#CONFIG_LV_FONT_MONTSERRAT_8=y
#CONFIG_LV_FONT_MONTSERRAT_10=y
#CONFIG_LV_FONT_MONTSERRAT_12=y
#CONFIG_LV_FONT_MONTSERRAT_14=y
CONFIG_LV_FONT_MONTSERRAT_16=y
#CONFIG_LV_FONT_MONTSERRAT_18=y
#CONFIG_LV_FONT_MONTSERRAT_20=y
#CONFIG_LV_FONT_MONTSERRAT_22=y
#CONFIG_LV_FONT_MONTSERRAT_24=y
#CONFIG_LV_FONT_MONTSERRAT_26=y
#CONFIG_LV_FONT_MONTSERRAT_28=y
#CONFIG_LV_FONT_MONTSERRAT_30=y
#CONFIG_LV_FONT_MONTSERRAT_32=y
#CONFIG_LV_FONT_MONTSERRAT_34=y
#CONFIG_LV_FONT_MONTSERRAT_36=y
#CONFIG_LV_FONT_MONTSERRAT_38=y
#CONFIG_LV_FONT_MONTSERRAT_40=y
#CONFIG_LV_FONT_MONTSERRAT_42=y
#CONFIG_LV_FONT_MONTSERRAT_44=y
#CONFIG_LV_FONT_FMT_TXT_LARGE=y
#CONFIG_LV_USE_FONT_COMPRESSED=y

# LVGL Lottie Animation Configuration
CONFIG_LV_USE_VECTOR_GRAPHIC=y
CONFIG_LV_USE_THORVG=y
CONFIG_LV_USE_THORVG_INTERNAL=y
CONFIG_LV_USE_CANVAS=y
CONFIG_LV_USE_LOTTIE=y

CONFIG_LV_USE_CLIB_MALLOC=y

CONFIG_ESP_TIMER_TASK_STACK_SIZE=3584

CONFIG_SPIRAM_ALLOW_BSS_SEG_EXTERNAL_MEMORY=y
CONFIG_SPIRAM_ALLOW_NOINIT_SEG_EXTERNAL_MEMORY=y

#LVGL Demo Configuration
#CONFIG_LV_USE_DEMO_WIDGETS=y
#CONFIG_LV_DEMO_WIDGETS_SLIDESHOW=y
#CONFIG_LV_USE_DEMO_KEYPAD_AND_ENCODER=y
#CONFIG_LV_USE_DEMO_BENCHMARK=y
#CONFIG_LV_USE_DEMO_STRESS=y
#CONFIG_LV_USE_DEMO_MUSIC=y
CONFIG_LV_DEF_REFR_PERIOD=100
```
